#define VERSION_MACRO
macro_ver: macro_ver {
compatible = "zmk,behavior-macro";
label = "macro_ver";
#binding-cells = <0>;
bindings = <&kp N2>, <&kp N0>, <&kp N2>, <&kp N4>, <&kp N0>, <&kp N7>, <&kp N0>, <&kp N2>, <&kp MINUS>, <&kp W>, <&kp H>, <&kp E>, <&kp E>, <&kp MINUS>, <&kp N1>, <&kp N2>, <&kp F>, <&kp N9>, <&kp N5>, <&kp N3>, <&kp N1>, <&kp RET>;
};
